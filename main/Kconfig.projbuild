## sdkconfig.defaults.esp32s3.board-devkit-mini
```kconfig
# ESP32-S3-DevKitM-1 / WEMOS LOLIN Mini (ESP32-S3-MINI-1 on carrier).
# Wiring: WIRING-ESP32S3-LORA-GPS.md § DevKit Mini
#
# Module flash: 4 MB (typical ESP32-S3-MINI-1-N4).
# CONFIG_ESPTOOLPY_FLASHSIZE_8MB is not set
CONFIG_ESPTOOLPY_FLASHSIZE_4MB=y

CONFIG_REGATTAONE_S3_BOARD_DEVKIT_MINI=y
# CONFIG_REGATTAONE_S3_BOARD_WAVESHARE_ZERO is not set

# SEN0140 IMU (I2C)
CONFIG_SEN0140_I2C_SDA_GPIO=10
CONFIG_SEN0140_I2C_SCL_GPIO=11

# SX1262 LoRa (SPI2 / FSPI)
CONFIG_SX1262_SPI_HOST_NUM=2
CONFIG_SX1262_SPI_MOSI_GPIO=13
CONFIG_SX1262_SPI_MISO_GPIO=14
CONFIG_SX1262_SPI_SCLK_GPIO=12
CONFIG_SX1262_SPI_CS_GPIO=9
CONFIG_SX1262_RESET_GPIO=8
CONFIG_SX1262_DIO1_GPIO=7
CONFIG_SX1262_BUSY_GPIO=6

# REYAX RYUW122 UWB (UART1)
CONFIG_RYUW122_UART_PORT_NUM=1
CONFIG_RYUW122_UART_TX_GPIO=17
CONFIG_RYUW122_UART_RX_GPIO=18
```
